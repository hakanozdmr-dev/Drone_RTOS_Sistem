#include "ssd1306.h"
#include <string.h>

// --- KRİTİK DÜZELTME BURADA ---
// Main.c dosyasında hi2c2 tanımladığımız için burada da onu çağırıyoruz.
extern I2C_HandleTypeDef hi2c2;

static uint8_t SSD1306_Buffer[SSD1306_WIDTH * SSD1306_HEIGHT / 8];

// --- STANDART ASCII FONT (32-126) ---
const uint8_t Font5x7[][5] = {
    {0x00, 0x00, 0x00, 0x00, 0x00}, // (space)
    {0x00, 0x00, 0x5f, 0x00, 0x00}, // !
    {0x00, 0x07, 0x00, 0x07, 0x00}, // "
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    {0x44, 0x64, 0x54, 0x4c, 0x44}  // z
};

// I2C Komut Gönderme (hi2c2 kullanacak)
void SSD1306_WriteCommand(uint8_t command) {
    HAL_I2C_Mem_Write(&hi2c2, SSD1306_I2C_ADDR, 0x00, 1, &command, 1, 10);
}

// I2C Veri Gönderme (hi2c2 kullanacak)
void SSD1306_WriteData(uint8_t* data, uint16_t size) {
    HAL_I2C_Mem_Write(&hi2c2, SSD1306_I2C_ADDR, 0x40, 1, data, size, 100);
}

// Ekranı Başlat
void SSD1306_Init(void) {
    HAL_Delay(100);
    uint8_t init_cmds[] = {
        0xAE, 0x20, 0x00, 0xB0, 0xC8, 0x00, 0x10, 0x40, 0x81, 0xFF, 0xA1, 0xA6,
        0xA8, 0x3F, 0xA4, 0xD3, 0x00, 0xD5, 0xF0, 0xD9, 0x22, 0xDA, 0x12, 0xDB,
        0x20, 0x8D, 0x14, 0xAF
    };
    for(int i=0; i<sizeof(init_cmds); i++) SSD1306_WriteCommand(init_cmds[i]);

    SSD1306_Fill(0);
    SSD1306_UpdateScreen();
}

// Ekran Tamponunu Doldur
void SSD1306_Fill(uint8_t color) {
    memset(SSD1306_Buffer, (color ? 0xFF : 0x00), sizeof(SSD1306_Buffer));
}

// Tamponu Ekrana Gönder
void SSD1306_UpdateScreen(void) {
    for (uint8_t i = 0; i < 8; i++) {
        SSD1306_WriteCommand(0xB0 + i);
        SSD1306_WriteCommand(0x00);
        SSD1306_WriteCommand(0x10);
        SSD1306_WriteData(&SSD1306_Buffer[SSD1306_WIDTH * i], SSD1306_WIDTH);
    }
}

// Piksel Çiz
void SSD1306_DrawPixel(uint8_t x, uint8_t y, uint8_t color) {
    if (x >= SSD1306_WIDTH || y >= SSD1306_HEIGHT) return;
    if (color) SSD1306_Buffer[x + (y / 8) * SSD1306_WIDTH] |= (1 << (y % 8));
    else       SSD1306_Buffer[x + (y / 8) * SSD1306_WIDTH] &= ~(1 << (y % 8));
}

// Karakter Yaz
void SSD1306_WriteChar(char ch, uint8_t x, uint8_t y, uint8_t color) {
    if(ch < 32 || ch > 126) return;
    uint8_t index = ch - 32;

    for(uint8_t i = 0; i < 5; i++) {
        uint8_t b = Font5x7[index][i];
        for(uint8_t j = 0; j < 8; j++) {
            if((b >> j) & 0x01) SSD1306_DrawPixel(x + i, y + j, color);
            else                SSD1306_DrawPixel(x + i, y + j, !color);
        }
    }
}

// String Yaz
void SSD1306_WriteString(char* str, uint8_t x, uint8_t y, uint8_t color) {
    while(*str) {
        SSD1306_WriteChar(*str, x, y, color);
        x += 6;
        str++;
    }
}
